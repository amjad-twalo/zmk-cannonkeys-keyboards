## boards/shields/photon_dongle/Kconfig.defconfig
```kconfig
if SHIELD_PHOTON_DONGLE

config ZMK_KEYBOARD_NAME
    default "Photon Dongle"

config ZMK_BOARD_COMPAT
    def_bool y

# Dongle is the USB HID device — USB must always be enabled
config ZMK_USB
    default y

# Let ZMK control USB init — xiao_ble sets INITIALIZE_AT_BOOT=y which
# causes usb_enable() to be called before ZMK sets up HID endpoints
config USB_DEVICE_INITIALIZE_AT_BOOT
    default n

# BLE is required for the split central to scan and connect to the peripheral
config ZMK_BLE
    default y

config BT_CTLR
    default BT

config ZMK_SPLIT
    default y

config ZMK_SPLIT_ROLE_CENTRAL
    default y

config ZMK_SPLIT_BLE_CENTRAL_PERIPHERALS
    default 1

# 1 peripheral + 5 BLE profiles + 1 headroom
config BT_MAX_CONN
    default 7

config BT_MAX_PAIRED
    default 7

# Improve BLE connection stability for split communication
config ZMK_BLE_EXPERIMENTAL_CONN
    default y

# Larger ACL buffers for reliable split data transfer
config BT_BUF_ACL_RX_SIZE
    default 255

config BT_BUF_ACL_TX_SIZE
    default 255

# Disable BLE privacy — use a stable address so the peripheral's
# directed advertising can find us after a reboot
config BT_PRIVACY
    default n

endif # SHIELD_PHOTON_DONGLE
```

## boards/shields/photon_dongle/Kconfig.shield
```kconfig
# Copyright (c) 2024 CannonKeys LLC
# SPDX-License-Identifier: MIT

config SHIELD_PHOTON_DONGLE
    def_bool $(shields_list_contains,photon_dongle)
```

## boards/shields/settings_reset/Kconfig.defconfig
```kconfig
# Copyright (c) 2024 CannonKeys LLC
# SPDX-License-Identifier: MIT

if SHIELD_SETTINGS_RESET

config ZMK_BOARD_COMPAT
    default y

config ZMK_KEYBOARD_NAME
    default "Settings Reset"

endif # SHIELD_SETTINGS_RESET
```
